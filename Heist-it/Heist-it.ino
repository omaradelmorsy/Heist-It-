//Some libraries I needed them 
#include <Wire.h>
#include <Servo.h>

#define GREEN_LED     8
#define RED_LED       9
#define SERVO_PIN     10
#define ENCODER_PIN   A0
#define REED_PIN      A1
#define START_BTN_PIN 2

#define VCNL_ADDR     0x60
#define OLED_ADDR     0x3C

#define PROX_THRESHOLD 2000

Servo servo;

int score        = 0;
unsigned long timeLeft = 60000;
bool playing     = false;

int dialCount    = 0;
int dialBase     = 0;
bool lastEncoder = false;
bool gameStart   = false;

int jiggleCount  = 0;
bool lastMagnet  = false;
bool fireArmed   = false;
bool jiggleArmed = false;
bool vcnlArmed   = false;

enum Move { DIAL, FIRE, JIGGLE };



void greenOn() {
  digitalWrite(GREEN_LED, HIGH);
  digitalWrite(RED_LED, LOW);
}

void redOn() {
  digitalWrite(GREEN_LED, LOW);
  digitalWrite(RED_LED, HIGH);
}

void ledsOff() {
  digitalWrite(GREEN_LED, LOW);
  digitalWrite(RED_LED, LOW);
}

void blink(bool green, int times, int ms) {
  for (int i = 0; i < times; i++) {
    green ? greenOn() : redOn();
    delay(ms);
    ledsOff();
    delay(ms);
  }
}



void lock()   { servo.write(0);  delay(300); }
void unlock() { servo.write(90); delay(300); }



void resetDial() { dialBase = dialCount; }
int  getDial()   { return dialCount - dialBase; }



void i2cSend(uint8_t addr, uint8_t reg, uint8_t val) {
  Wire.beginTransmission(addr);
  Wire.write(reg);
  Wire.write(val);
  Wire.endTransmission();
}

void i2cSend16(uint8_t addr, uint8_t reg, uint8_t low, uint8_t high) {
  Wire.beginTransmission(addr);
  Wire.write(reg);
  Wire.write(low);
  Wire.write(high);
  Wire.endTransmission();
}

uint16_t i2cGet(uint8_t addr, uint8_t reg) {
  Wire.beginTransmission(addr);
  Wire.write(reg);
  Wire.endTransmission(false);
  Wire.requestFrom(addr, (uint8_t)2);
  uint16_t lo = Wire.read();
  uint16_t hi = Wire.read();
  return (hi << 8) | lo;
}




void dfSend(const char* cmd) {
  Serial.print(cmd);
  Serial.print("\r\n");
  delay(100);
}

void play(int track) {
  char cmd[30];
  sprintf(cmd, "AT+PLAYFILE=/000%d.mp3", track);
  Serial.print(cmd);
  Serial.print("\r\n");
  delay(200);
}

void setupAudio() {
  Serial.begin(115200);
  delay(1000);
  dfSend("AT+PLAYMODE=3");  // single play — plays one file then stops
  delay(300);
  dfSend("AT+SAVE");        // save to memory permanently
  delay(300);
  dfSend("AT+VOL=20");      // volume 0-30
  delay(200);
  dfSend("AT+PAUSE");       // stop anything playing
  delay(200);
}



void setupProximity() {
  i2cSend(VCNL_ADDR,   0x00, 0x01);
  i2cSend16(VCNL_ADDR, 0x03, 0x04, 0x08);
  i2cSend16(VCNL_ADDR, 0x04, 0x00, 0x07);
}

bool magnetClose() {
  return i2cGet(VCNL_ADDR, 0x08) > PROX_THRESHOLD;
}



bool reedTriggered() {
  int r1 = analogRead(REED_PIN);
  delay(5);
  int r2 = analogRead(REED_PIN);
  delay(5);
  int r3 = analogRead(REED_PIN);
  return (r1 > 700 && r2 > 700 && r3 > 700);
}



void pollEncoder() {
  bool current = (analogRead(ENCODER_PIN) > 512);
  if (current && !lastEncoder) {
    if (!playing)
      gameStart = true;
    else
      dialCount++;
  }
  lastEncoder = current;
}

void resetJiggle() {
  jiggleCount  = 0;
  lastMagnet   = magnetClose();
  fireArmed    = false;
  jiggleArmed  = false;
  vcnlArmed    = false;
}

void pollJiggle() {
  bool current = magnetClose();
  if (!jiggleArmed) {
    if (!current) jiggleArmed = true;
    lastMagnet = current;
    return;
  }
  if (current && !lastMagnet)
    jiggleCount++;
  lastMagnet = current;
}

void pollFireArm() {
  if (!fireArmed && !reedTriggered()) {
    fireArmed = true;
  }
}

void pollVcnlArm() {
  if (!vcnlArmed && !magnetClose()) {
    vcnlArmed = true;
  }
}



void oledCmd(uint8_t cmd) {
  Wire.beginTransmission(OLED_ADDR);
  Wire.write(0x00);
  Wire.write(cmd);
  Wire.endTransmission();
}

void oledData(uint8_t data) {
  Wire.beginTransmission(OLED_ADDR);
  Wire.write(0x40);
  Wire.write(data);
  Wire.endTransmission();
}

void oledInit() {
  delay(100);
  oledCmd(0xAE);
  oledCmd(0xA8); oledCmd(0x3F);
  oledCmd(0xD3); oledCmd(0x00);
  oledCmd(0x40);
  oledCmd(0xA1);
  oledCmd(0xC8);
  oledCmd(0xDA); oledCmd(0x12);
  oledCmd(0x81); oledCmd(0xCF);
  oledCmd(0xA4);
  oledCmd(0xA6);
  oledCmd(0xD5); oledCmd(0x80);
  oledCmd(0xD9); oledCmd(0xF1);
  oledCmd(0xDB); oledCmd(0x40);
  oledCmd(0x20); oledCmd(0x00);
  oledCmd(0x8D); oledCmd(0x14);
  oledCmd(0xAF);
}

void oledClear() {
  for (uint8_t page = 0; page < 8; page++) {
    oledCmd(0xB0 + page);
    oledCmd(0x00);
    oledCmd(0x10);
    for (uint8_t col = 0; col < 128; col++)
      oledData(0x00);
  }
}

void oledSetCursor(uint8_t col, uint8_t page) {
  oledCmd(0xB0 + page);
  oledCmd(0x00 + (col & 0x0F));
  oledCmd(0x10 + (col >> 4));
}

const uint8_t font5x7[][5] = {
  {0x7E,0x11,0x11,0x11,0x7E}, // A
  {0x7F,0x49,0x49,0x49,0x36}, // B
  {0x3E,0x41,0x41,0x41,0x22}, // C
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  {0x00,0x41,0x22,0x14,0x08}, // )
};

int charIndex(char c) {
  if (c >= 'A' && c <= 'Z') return c - 'A';
  if (c >= '0' && c <= '9') return c - '0' + 26;
  if (c == ' ') return 36;
  if (c == '!') return 37;
  if (c == ':') return 38;
  if (c == '-') return 39;
  if (c == ')') return 40;
  return 36;
}

void oledChar(char c) {
  int idx = charIndex(c);
  for (int i = 0; i < 5; i++)
    oledData(font5x7[idx][i]);
  oledData(0x00);
}

void oledText(uint8_t col, uint8_t page, const char* str) {
  oledSetCursor(col, page);
  while (*str)
    oledChar(*str++);
}

void oledLine(uint8_t page) {
  oledSetCursor(0, page);
  for (int i = 0; i < 128; i++)
    oledData(0xFF);
}



const uint8_t bigDigit[10][3][16] = {
  // 0
  {{0xF0,0xF8,0x0C,0x06,0x06,0x06,0x0C,0xF8,0xF0,0x00,0x00,0x00,0x00,0x00,0x00,0x00},
   {0xFF,0xFF,0x00,0x00,0x00,0x00,0x00,0xFF,0xFF,0x00,0x00,0x00,0x00,0x00,0x00,0x00},
   {0x0F,0x1F,0x30,0x60,0x60,0x60,0x30,0x1F,0x0F,0x00,0x00,0x00,0x00,0x00,0x00,0x00}},
  // 1
  {{0x00,0x18,0x0C,0xFE,0xFF,0x00,0x00,0x00,0x00,0x00,0x00,0x00,0x00,0x00,0x00,0x00},
   {0x00,0x00,0x00,0xFF,0xFF,0x00,0x00,0x00,0x00,0x00,0x00,0x00,0x00,0x00,0x00,0x00},
   {0x00,0x60,0x60,0x7F,0x7F,0x60,0x60,0x00,0x00,0x00,0x00,0x00,0x00,0x00,0x00,0x00}},
  // 2
  {{0x0C,0x06,0x06,0x06,0x86,0xFC,0xF8,0x00,0x00,0x00,0x00,0x00,0x00,0x00,0x00,0x00},
   {0xC0,0xE0,0x70,0x1C,0x0F,0x03,0x00,0x00,0x00,0x00,0x00,0x00,0x00,0x00,0x00,0x00},
   {0x7F,0x7F,0x61,0x60,0x60,0x60,0x60,0x00,0x00,0x00,0x00,0x00,0x00,0x00,0x00,0x00}},
  // 3
  {{0x06,0x06,0x46,0x46,0xC6,0xBC,0x38,0x00,0x00,0x00,0x00,0x00,0x00,0x00,0x00,0x00},
   {0x00,0x18,0x19,0x19,0x19,0xFF,0xE6,0x00,0x00,0x00,0x00,0x00,0x00,0x00,0x00,0x00},
   {0x30,0x60,0x60,0x60,0x60,0x3F,0x1F,0x00,0x00,0x00,0x00,0x00,0x00,0x00,0x00,0x00}},
  // 4
  {{0xC0,0xE0,0x30,0x18,0xFF,0xFF,0x00,0x00,0x00,0x00,0x00,0x00,0x00,0x00,0x00,0x00},
   {0x03,0x03,0x03,0x03,0xFF,0xFF,0x03,0x00,0x00,0x00,0x00,0x00,0x00,0x00,0x00,0x00},
   {0x00,0x00,0x00,0x00,0x7F,0x7F,0x00,0x00,0x00,0x00,0x00,0x00,0x00,0x00,0x00,0x00}},
  // 5
  {{0x7E,0x7E,0x46,0x46,0xC6,0x86,0x06,0x00,0x00,0x00,0x00,0x00,0x00,0x00,0x00,0x00},
   {0x01,0x19,0x19,0x19,0x19,0xF9,0xF0,0x00,0x00,0x00,0x00,0x00,0x00,0x00,0x00,0x00},
   {0x30,0x60,0x60,0x60,0x60,0x3F,0x1F,0x00,0x00,0x00,0x00,0x00,0x00,0x00,0x00,0x00}},
  // 6
  {{0xF8,0xFC,0x46,0x46,0xC6,0x86,0x06,0x00,0x00,0x00,0x00,0x00,0x00,0x00,0x00,0x00},
   {0xFF,0xFF,0x19,0x19,0x19,0xF9,0xF0,0x00,0x00,0x00,0x00,0x00,0x00,0x00,0x00,0x00},
   {0x1F,0x3F,0x61,0x60,0x60,0x3F,0x1F,0x00,0x00,0x00,0x00,0x00,0x00,0x00,0x00,0x00}},
  // 7
  {{0x06,0x06,0x06,0xC6,0xF6,0x3E,0x0E,0x00,0x00,0x00,0x00,0x00,0x00,0x00,0x00,0x00},
   {0x00,0x00,0xF8,0xFF,0x07,0x00,0x00,0x00,0x00,0x00,0x00,0x00,0x00,0x00,0x00,0x00},
   {0x00,0x00,0x7F,0x7F,0x00,0x00,0x00,0x00,0x00,0x00,0x00,0x00,0x00,0x00,0x00,0x00}},
  // 8
  {{0x38,0xBC,0xC6,0x46,0x46,0xC6,0xBC,0x38,0x00,0x00,0x00,0x00,0x00,0x00,0x00,0x00},
   {0xE6,0xFF,0x19,0x19,0x19,0x19,0xFF,0xE6,0x00,0x00,0x00,0x00,0x00,0x00,0x00,0x00},
   {0x1F,0x3F,0x61,0x60,0x60,0x61,0x3F,0x1F,0x00,0x00,0x00,0x00,0x00,0x00,0x00,0x00}},
  // 9
  {{0x38,0xBC,0xC6,0x46,0x46,0xFE,0xFC,0x00,0x00,0x00,0x00,0x00,0x00,0x00,0x00,0x00},
   {0x01,0x19,0x19,0x19,0x19,0xFF,0xFF,0x00,0x00,0x00,0x00,0x00,0x00,0x00,0x00,0x00},
   {0x30,0x60,0x60,0x60,0x61,0x3F,0x1F,0x00,0x00,0x00,0x00,0x00,0x00,0x00,0x00,0x00}},
};

void oledBigDigit(uint8_t col, uint8_t startPage, uint8_t digit) {
  for (uint8_t p = 0; p < 3; p++) {
    oledSetCursor(col, startPage + p);
    for (uint8_t i = 0; i < 16; i++)
      oledData(bigDigit[digit][p][i]);
  }
}


void showScore(int s) {
  oledClear();
  oledText(22, 0, "HEIST-IT!");
  oledLine(1);
  if (s < 10)
    oledBigDigit(56, 2, s);          // single digit centered
  else if (s < 100) {
    oledBigDigit(36, 2, s / 10);     // first digit
    oledBigDigit(72, 2, s % 10);     // second digit
  } else {
    oledBigDigit(8,  2, s / 100);         // hundreds
    oledBigDigit(46, 2, (s / 10) % 10);  // tens
    oledBigDigit(84, 2, s % 10);         // ones
  }
}

void showMessage(const char* line1, const char* line2) {
  oledClear();
  int len1 = strlen(line1);
  int len2 = strlen(line2);
  uint8_t x1 = (21 - len1) * 3;
  uint8_t x2 = (21 - len2) * 3;
  oledText(max(0, (int)x1), 2, line1);
  oledText(max(0, (int)x2), 5, line2);
}

void showCommand(const char* cmd) {
  oledClear();
  oledText(22, 0, "HEIST-IT!");
  oledLine(1);
  int len = strlen(cmd);
  uint8_t x = (21 - len) * 3;
  oledText(max(0, (int)x), 3, cmd);
}

void showWaiting() {
  oledClear();
  oledText(10, 0, "HEIST-IT!");
  oledLine(1);
  oledText(4, 3, "PRESS SW1 TO");
  oledText(10, 5, "START GAME");
}


Move pickMove() {
  return (Move)random(0, 3);
}

void giveCommand(Move m) {
  resetDial();
  resetJiggle();
  delay(150);

  if (m == DIAL)   { play(1); showCommand("DIAL IT!");   }
  if (m == FIRE)   { play(2); showCommand("FIRE IT!");   }
  if (m == JIGGLE) { play(3); showCommand("JIGGLE IT!"); }

  resetDial();
  resetJiggle();
  lastEncoder = (analogRead(ENCODER_PIN) > 512);
  delay(50);
}

bool gotItRight(Move m) {
  if (m == DIAL)   return getDial() >= 2;
  if (m == FIRE)   return fireArmed && reedTriggered();
  if (m == JIGGLE) return jiggleArmed && jiggleCount >= 1;
  return false;
}

bool gotItWrong(Move m) {
  if (m == DIAL)   return reedTriggered() || (vcnlArmed && magnetClose());
  if (m == FIRE)   return fireArmed && (getDial() >= 2 || (vcnlArmed && magnetClose()));
  if (m == JIGGLE) return jiggleArmed && reedTriggered();
  return false;
}

void win() {
  play(6);
  unlock();
  showMessage("YOU WIN!", "DIAMOND  )");
  blink(true, 10, 120);
  playing = false;
}

void lose() {
  play(5);
  lock();
  showMessage("CAUGHT!", "GAME OVER");
  blink(false, 6, 180);
  playing = false;
}

void startNewGame() {
  score       = 0;
  timeLeft    = 60000;
  dialCount   = 0;
  dialBase    = 0;
  lastEncoder = (analogRead(ENCODER_PIN) > 512);
  lock();
  ledsOff();
  blink(true, 2, 150);
  delay(1200);
  showScore(0);
  playing = true;
}



void setup() {
  pinMode(GREEN_LED,     OUTPUT);
  pinMode(RED_LED,       OUTPUT);
  ledsOff();

  pinMode(ENCODER_PIN,   INPUT);
  pinMode(REED_PIN,      INPUT);
  pinMode(START_BTN_PIN, INPUT_PULLUP);

  servo.attach(SERVO_PIN);
  lock();

  Wire.begin();
  oledInit();
  oledClear();

  setupProximity();
  setupAudio();

  randomSeed(analogRead(A2));
  blink(true, 3, 100);
  showWaiting();
}

void loop() {
  pollEncoder();

  if (!playing) {
    greenOn(); delay(400);
    ledsOff(); delay(400);

    if (gameStart || digitalRead(START_BTN_PIN) == LOW) {
      delay(50);
      gameStart = false;
      startNewGame();
    }
    return;
  }

  Move current = pickMove();
  giveCommand(current);

  unsigned long deadline = millis() + timeLeft;
  bool done = false;

  while (millis() < deadline) {
    pollEncoder();
    if (current == JIGGLE) pollJiggle();
    if (current == FIRE)   pollFireArm();
    if (current == DIAL || current == FIRE) pollVcnlArm();

    if (gotItWrong(current)) {
      lose();
      done = true;
      break;
    }

    if (gotItRight(current)) {
      score++;
      showScore(score);
      greenOn();
      play(4);
      delay(500);
      ledsOff();
      timeLeft -= 50;
      if (timeLeft < 400)   timeLeft = 400;
      if (timeLeft > 60000) timeLeft = 60000;
      done = true;
      break;
    }

    delay(20);
  }

  if (!done) lose();
  if (playing && score >= 99) win();
  if (!playing) {
    delay(3000);
    showWaiting();
  }
}
